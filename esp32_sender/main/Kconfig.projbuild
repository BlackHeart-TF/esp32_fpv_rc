## esp32_sender/main/Kconfig.projbuild
```kconfig
menu "Camera Pin Configuration"
    config CAMERA_MIRROR
        bool "H-Mirror Camera"
        default y

    config CAMERA_FLIP
        bool "V-Flip Camera"
        default y
        
    config M5STACK_UNITCAM
        bool "M5Stack UnitCam"
        default n

    config M5STACK_UNITCAM_S3
        bool "M5Stack UnitCam S3"
        default y

    config M5STACK_CORES3
        bool "M5Stack CoreS3"
        default y

    config XIAO_ESP32S3_SENSE
        bool "Xiao ESP32S3 Sense"
        default n

    config FREENOVE_ESP32S3_CAM
        bool "Freenove ESP32S3 Cam"
        default n

    config CUSTOM_CAMERA_PINS
        bool "Custom Pin Configuration"
        default n

    config PWDN_GPIO_NUM
        int "PWDN_GPIO_NUM"
        default -1
        depends on CUSTOM_CAMERA_PINS

    config RESET_GPIO_NUM
        int "RESET_GPIO_NUM"
        default -1
        depends on CUSTOM_CAMERA_PINS

    config XCLK_GPIO_NUM
        int "XCLK_GPIO_NUM"
        default 15
        depends on CUSTOM_CAMERA_PINS

    config SIOD_GPIO_NUM
        int "SIOD_GPIO_NUM"
        default 4
        depends on CUSTOM_CAMERA_PINS

    config SIOC_GPIO_NUM
        int "SIOC_GPIO_NUM"
        default 5
        depends on CUSTOM_CAMERA_PINS


    config Y2_GPIO_NUM
        int "Y2_GPIO_NUM"
        default 11
        depends on CUSTOM_CAMERA_PINS

    config Y3_GPIO_NUM
        int "Y3_GPIO_NUM"
        default 9
        depends on CUSTOM_CAMERA_PINS

    config Y4_GPIO_NUM
        int "Y4_GPIO_NUM"
        default 8
        depends on CUSTOM_CAMERA_PINS

    config Y5_GPIO_NUM
        int "Y5_GPIO_NUM"
        default 10
        depends on CUSTOM_CAMERA_PINS

    config Y6_GPIO_NUM
        int "Y6_GPIO_NUM"
        default 12
        depends on CUSTOM_CAMERA_PINS

    config Y7_GPIO_NUM
        int "Y7_GPIO_NUM"
        default 18
        depends on CUSTOM_CAMERA_PINS

    config Y8_GPIO_NUM
        int "Y8_GPIO_NUM"
        default 17
        depends on CUSTOM_CAMERA_PINS

    config Y9_GPIO_NUM
        int "Y9_GPIO_NUM"
        default 16
        depends on CUSTOM_CAMERA_PINS


    config VSYNC_GPIO_NUM
        int "VSYNC_GPIO_NUM"
        default 6
        depends on CUSTOM_CAMERA_PINS

    config HREF_GPIO_NUM
        int "HREF_GPIO_NUM"
        default 7
        depends on CUSTOM_CAMERA_PINS

    config PCLK_GPIO_NUM
        int "PCLK_GPIO_NUM"
        default 13
        depends on CUSTOM_CAMERA_PINS


endmenu
menu "Servo Configuration"
    config USE_8SERVOS_UNIT
        bool "Use M5 8Servos Unit"
        default n
        help
            Use the M5Stack *Servos Unit to control the servos. (only choose 1)
        config SCL_PIN
            int "SCL Pin"
            default 33
            depends on USE_8SERVOS_UNIT
        
        config SDA_PIN
            int "SDA Pin"
            default 32  
            depends on USE_8SERVOS_UNIT
        
        config SERVO_I2C_ADDR
            int "I2C Address"
            default 37  
            depends on USE_8SERVOS_UNIT

    config USE_GPIO_SERVO
        bool "Use GPIO Pins"
        default n
        help
            Use GPIO pins to control the servos directly, no additional hardware (only choose 1)
        config SERVO_X_PIN
            int "X Pin (Steering)"
            default 33
            depends on USE_GPIO_SERVO
        
        config SERVO_X_PIN
            int "Y Pin (Throttle)"
            default 32  
            depends on USE_GPIO_SERVO

endmenu
menu "WiFi Configuration"
    config ESP_WIFI_SSID
        string "WiFi SSID"
        default "myssid"
        help
            SSID (network name) for the example to connect to.

    config ESP_WIFI_PASSWORD
        string "WiFi Password"
        default "mypassword"
        help
            WiFi password (WPA or WPA2) for the example to use.

    config ESP_MAXIMUM_RETRY
        int "Maximum retry"
        default 5
        help
            Set the Maximum retry to avoid station reconnecting to the AP unlimited when the AP is really inexistent.

    config ESP_UDP_LOG
        bool "Log over UDP"
        default y
        help
            Log to udp packets, Useful for when the usb and servo controller use the same plug. Looking at you, M5 Unit camS3.

    config ESP_UDP_LOG_IP
        string "Log to Address"
        default "192.168.0.100"
        depends on ESP_UDP_LOG

    config ESP_UDP_LOG_PORT
        int "Log to Port"
        default 55557 
        depends on ESP_UDP_LOG
endmenu
```
